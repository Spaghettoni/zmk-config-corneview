## config/west.yml
```yaml
manifest:
  defaults:
    revision: v0.3
  remotes:
    - name: zmkfirmware
      url-base: https://github.com/zmkfirmware
    - name: Spaghettoni
      url-base: https://github.com/Spaghettoni
  projects:
    - name: zmk
      remote: zmkfirmware
      import: app/west.yml
    - name: nice-deez-nuts
      remote: Spaghettoni
      revision: main
  self:
    path: config
```
